## conf/distro/blacklist.conf
```bitbake
#
# Copyright (C) 2013 - 2014 Wind River Systems, Inc.
#
# Explicitly disallow these recipes in wrlinux

# PNBLACKLIST[PN] = "reason"

# Miscellaneous
#

INHERIT_BLACKLIST = "blacklist"

# Remove blacklist once the build appliance is supported.
PNBLACKLIST[build-appliance-image] = "The build appliance image is not supported at this time."
PNBLACKLIST[ajenti] = "The ajenti recipe does not have various required python modules available, this recipe is not supported."
PNBLACKLIST[qt-mobility-x11] = "The qt-mobility-x11 recipe is not supported at this time."
PNBLACKLIST[qt-mobility-embedded] = "The qt-mobility-embedded recipe is not supported at this time."
```

## conf/distro/exclude-from-world.conf
```bitbake
# The pkgs that are excluded from the world build, remember to fix them
# before release.

# It is only for x86-64, ARMv6 and ARMv7 target
# LIN7-637
EXCLUDE_FROM_WORLD_pn-criu = "1"

# We had disabled the protobuf in wr-kernel layer, we need disable
# protobuf-c, too, since it depends on protobuf.
EXCLUDE_FROM_WORLD_pn-protobuf-c = "1"

# LIN7-2351
EXCLUDE_FROM_WORLD_pn-efitools = "1"

# LIN8-299
EXCLUDE_FROM_WORLD_pn-snort = "1"

# LIN8-298
EXCLUDE_FROM_WORLD_pn-wr-coverageagent = "1"

# LIN8-382, curlpp depends on boost while boost failed on qemumips
EXCLUDE_FROM_WORLD_pn-boost = "1"
EXCLUDE_FROM_WORLD_pn-curlpp = "1"

# LIN8-751
EXCLUDE_FROM_WORLD_pn-libhugetlbfs = "1"

# LIN8-800
EXCLUDE_FROM_WORLD_arm_pn-gnu-efi = "1"

# TA108085
EXCLUDE_FROM_WORLD_pn-libnet-dns-perl = "1"

# LIN8-846
EXCLUDE_FROM_WORLD_pn-ltp = "1"

# LIN8-845
EXCLUDE_FROM_WORLD_pn-xl2tpd = "1"

# LIN8-835
EXCLUDE_FROM_WORLD_pn-gcc = "1"
```

## conf/distro/include/security_flags_wrs.inc
```bitbake
# Base on oe-core security flags
include conf/distro/include/security_flags.inc

# To override for multilib, use SECURITY_CFLAGS_pn-<pkg>_pn-<mlib>-<pkg>.
# If just SECURITY_CFLAGS_pn-<pkg> is defined, it will be used for all
# multilib variants, too.
#

# Deal with ppc specific linker failures when using the cflags
SECURITY_CFLAGS_pn-glibc-initial_powerpc = ""
SECURITY_CFLAGS_pn-glibc_powerpc = ""
SECURITY_CFLAGS_pn-wireshark_powerpc = ""
SECURITY_CFLAGS_pn-rpm_powerpc64 = ""
SECURITY_STACK_PROTECTOR_pn-libmatchbox_powerpc = ""

# No _FORTIFY_SOURCE in CLFAGS
lcl_maybe_fortify_pn-c-ares = ""
lcl_maybe_fortify_pn-curl = ""
lcl_maybe_fortify_pn-openjdk-7 = ""
lcl_maybe_fortify_pn-openjdk-8 = ""
lcl_maybe_fortify_pn-relayd = ""
lcl_maybe_fortify_pn-libunwind = ""
lcl_maybe_fortify_pn-pth = ""

SECURITY_CFLAGS_pn-curlpp = ""
SECURITY_CFLAGS_pn-efitools = " "
SECURITY_CFLAGS_pn-grub-efi = " "
SECURITY_CFLAGS_pn-kexec-tools_mips64 = "-fstack-protector-all"
SECURITY_CFLAGS_append_pn-libhugetlbfs = " ${SECURITY_NOPIE_CFLAGS}"
SECURITY_CFLAGS_pn-squid = ""

TARGET_CFLAGS_remove_pn-lib32-directfb := "-fstack-protector-all -pie -fpie -D_FORTIFY_SOURCE=2"
TARGET_CFLAGS_remove_pn-directfb := "-fstack-protector-all -pie -fpie -D_FORTIFY_SOURCE=2"

SECURITY_LDFLAGS_remove_pn-dpdk = "-fstack-protector-strong"
SECURITY_LDFLAGS_remove_pn-libsign = "-fstack-protector-strong"

SECURITY_LDFLAGS_pn-netmap-modules_mips64 = " -z,relro,-z,now"
SECURITY_LDFLAGS_pn-cryptfs-tpm2 = ""

# Recipes which fail to compile when elevating -Wformat-security to an error
SECURITY_STRINGFORMAT_pn-boost = "${@bb.utils.contains('DISTRO_FEATURES', 'ptest', '', '-Wformat -Wformat-security -Werror=format-security', d)}"
SECURITY_STRINGFORMAT_pn-dnrd = ""
SECURITY_STRINGFORMAT_pn-iperf = ""
SECURITY_STRINGFORMAT_pn-libunique = ""
SECURITY_STRINGFORMAT_pn-linux-atm = ""
SECURITY_STRINGFORMAT_pn-makedumpfile = ""
SECURITY_STRINGFORMAT_pn-mipv6-daemon-umip = ""
SECURITY_STRINGFORMAT_pn-mysql-connector-odbc = ""
SECURITY_STRINGFORMAT_pn-netkit-rpc = ""
SECURITY_STRINGFORMAT_pn-netkit-telnet = ""
SECURITY_STRINGFORMAT_pn-ocfs2-tools = ""
SECURITY_STRINGFORMAT_pn-rdate = ""
SECURITY_STRINGFORMAT_pn-selinux-autorelabel = ""
SECURITY_STRINGFORMAT_pn-setools = ""
SECURITY_STRINGFORMAT_pn-xfce4-notes-plugin = ""
```

## conf/distro/include/wr-host-tools.inc
```bitbake
EXTRA_IMAGEDEPENDS += "unfs3-native"
EXTRA_IMAGEDEPENDS += "syslinux-native"
EXTRA_IMAGEDEPENDS += "qemu-native"
EXTRA_IMAGEDEPENDS += "qemu-helper-native"
EXTRA_IMAGEDEPENDS += "genext2fs-native"
```

## conf/distro/include/wrlinux-blacklist.conf
```bitbake
#
# Copyright (C) 2013 - 2015 Wind River Systems, Inc.
#
# Explicitly disallow these recipes in wrlinux

# PNBLACKLIST[PN] = "reason"

# Miscellaneous
#

INHERIT_BLACKLIST = "blacklist"

# Remove blacklist once the build appliance is supported.
PNBLACKLIST[build-appliance-image] = "The build appliance image is not supported at this time."
PNBLACKLIST[ajenti] = "The ajenti recipe does not have various required python modules available, this recipe is not supported."
PNBLACKLIST[qt-mobility-x11] = "The qt-mobility-x11 recipe is not supported at this time."
PNBLACKLIST[qt-mobility-embedded] = "The qt-mobility-embedded recipe is not supported at this time."
PNBLACKLIST[systemtap] ?= "Unsupported: perf is the preferred tool for system-wide debugging"
PNBLACKLIST[systemtap-uprobes] ?= "It depends on systemtap which is blacklisted."

# Explicitly allow these recipes in wrlinux
#
# Notes: weak assignments should be used for PNBLACKLIST in bb file
#        e.g. PNBLACKLIST[PN] ?= "reason"
#
# modphp and xdebug are blacklisted in meta-openembedded because they
# conflict with php, but we don't have the confliction since we are
# using subset of meta-openembedded and php is not included, so 
# unblacklist them here.
PNBLACKLIST[xdebug] = ""
PNBLACKLIST[modphp] = ""
```

## conf/distro/include/wrlinux-distro-settings.conf
```bitbake
# The recipes which are needed adjust during the build

# Workaround when DEBUG_BUILD = "1"
CFLAGS_pn-guile_append_arm = " -O2"
```

## conf/distro/include/wrlinux-exclude-from-world.conf
```bitbake
# The recipes that are excluded from the world build

# It is only for x86-64, ARMv6 and ARMv7 target
# LIN7-637
EXCLUDE_FROM_WORLD_pn-criu = "1"

# We had disabled the protobuf in wr-kernel layer, we need disable
# protobuf-c, too, since it depends on protobuf.
EXCLUDE_FROM_WORLD_pn-protobuf-c = "1"

# LIN7-2351
EXCLUDE_FROM_WORLD_pn-efitools = "1"

# CGP8-21
EXCLUDE_FROM_WORLD_pn-refpolicy-rbac = "1"

# CGP8-22
EXCLUDE_FROM_WORLD_pn-tpm-tools = "1"

# LIN9-808
EXCLUDE_FROM_WORLD_pn-refpolicy-targeted = "1"
EXCLUDE_FROM_WORLD_pn-refpolicy-minimum = "1"
PREFERRED_RPROVIDER_virtual/refpolicy = "refpolicy-mcs"
PREFERRED_RPROVIDER_virtual/lib32-refpolicy = "lib32-refpolicy-mcs"

# LIN9-1588
EXCLUDE_FROM_WORLD_pn-libvirt = "1"

# LIN9-1652
EXCLUDE_FROM_WORLD_pn-netmap-modules = "1"
EXCLUDE_FROM_WORLD_pn-netmap = "1"
# LIN9-1653
EXCLUDE_FROM_WORLD_pn-turbostat = "1"
```

## conf/distro/include/wrlinux-host-tools.inc
```bitbake
EXTRA_IMAGEDEPENDS += "unfs3-native"
EXTRA_IMAGEDEPENDS += "syslinux-native"
EXTRA_IMAGEDEPENDS += "qemu-native"
EXTRA_IMAGEDEPENDS += "qemu-helper-native"
EXTRA_IMAGEDEPENDS += "e2fsprogs-native"
EXTRA_IMAGEDEPENDS += "gdb-cross-${TARGET_ARCH}"

# copied from meta-mentor/conf/distro/include/sstate.inc
def lsb_distro_adjust(distro_id, ver):
    """This hook ensures that RHEL server, RHEL client, and CentOS all return
    'RedHat' for distro, and '5' for the version, as we know minor
    versions for these distros are compatible, and these distros are
    compatible with one another."""

    if distro_id in ('RedHatEnterpriseClient', 'RedHatEnterpriseServer',
                     'CentOS'):
        distro_id = 'RedHat'

        try:
            major_ver, _ = ver.split('.', 1)
        except ValueError:
            pass
        else:
            ver = major_ver
    return distro_id, ver

LSB_DISTRO_ADJUST = "lsb_distro_adjust"
```

## conf/distro/include/wrlinux-packageconfigs.inc
```bitbake
# PACKAGECONFIG settings of recipes for WRLinux

# Workaround for nmap possibly requiring python-pygtk which is not available
PACKAGECONFIG_remove_pn-nmap = "zenmap"

# we usually use gnutls as the default PACKAGECONFIG of wpa-supplicant, but its sub-packege gnutls-openssl
# is GPLv3, so need this check to switch to openssl if GLPv3 is blacklisted.
PACKAGECONFIG_pn-wpa-supplicant ?= "${@bb.utils.contains('INCOMPATIBLE_LICENSE', 'GPLv3', 'openssl', 'gnutls', d)}"
```

## conf/distro/include/wrlinux-whitelist.conf
```bitbake
#
# Copyright (C) 2013 - 2016 Wind River Systems, Inc.
#
# Explicitly allow these recipes in wrlinux
#
# PNWHITELIST_LAYERS = "layername"
# PNWHITELIST_layername = "recipe1 recipe2"
# PNWHITELIST_REASON_layername = "not supported by ${DISTRO}"
#
# Notes:
# - The layer name used here is actually the name that
#   gets added to BBFILE_COLLECTIONS in the layer's layer.conf
# - The recipe1 and recipe2 is the recipe's BPN.
#
# Currently, this is for all sublayers in meta-openembedded
#

INHERIT_DISTRO_append = " whitelist"

# Recipes in meta-networking and meta-webserver
# are all supported, so they are not listed here
PNWHITELIST_LAYERS = "\
    efl-layer \
    filesystems-layer \
    gnome-layer \
    gpe-layer \
    meta-initramfs \
    meta-python \
    multimedia-layer \
    openembedded-layer \
    perl-layer \
    ruby-layer \
    security \
    systemd-layer \
    toolchain-layer \
    xfce-layer \
"

# Reasons for recipes that are not whitelisted
PNWHITELIST_REASON_efl-layer = "Not supported by wrlinux"
PNWHITELIST_REASON_filesystems-layer = "Not supported by wrlinux"
PNWHITELIST_REASON_gnome-layer = "Not supported by wrlinux"
PNWHITELIST_REASON_gpe-layer = "Not supported by wrlinux"
PNWHITELIST_REASON_meta-initramfs = "Not supported by wrlinux"
PNWHITELIST_REASON_meta-python = "Not supported by wrlinux"
PNWHITELIST_REASON_multimedia-layer = "Not supported by wrlinux"
PNWHITELIST_REASON_openembedded-layer = "Not supported by wrlinux"
PNWHITELIST_REASON_perl-layer = "Not supported by wrlinux"
PNWHITELIST_REASON_ruby-layer = "Not supported by wrlinux"
PNWHITELIST_REASON_systemd-layer = "Not supported by wrlinux"
PNWHITELIST_REASON_toolchain-layer = "Not supported by wrlinux"
PNWHITELIST_REASON_xfce-layer = "Not supported by wrlinux"

PNWHITELIST_REASON_security ?= "Might be supported by wr-security addon"

# No recipe is supported in these layers by the core product,
# however addon's might whitelist individual recipes from these layers.
#
PNWHITELIST_efl-layer = ""
PNWHITELIST_gpe-layer = ""
PNWHITELIST_multimedia-layer = ""
PNWHITELIST_ruby-layer = ""
PNWHITELIST_security = ""
PNWHITELIST_systemd-layer = ""
PNWHITELIST_toolchain-layer = ""
PNWHITELIST_xfce-layer = ""

# meta-xfce and meta-multimedia are added as default
# corebranch layers, so add this to avoid QA warning
BBFILE_PATTERN_IGNORE_EMPTY_multimedia-layer = "1"
BBFILE_PATTERN_IGNORE_EMPTY_xfce-layer = "1"


# Whitelist for meta-openembedded/meta-filesystems
PNWHITELIST_filesystems-layer = "\
    fuse \
    sshfs-fuse \
    xfsdump \
    xfsprogs \
"

# Whitelist for meta-openembedded/meta-gnome
PNWHITELIST_gnome-layer = "\
    gsettings-desktop-schemas \
    libgtop \
    metacity \
"

# Whitelist for meta-openembedded/meta-oe
PNWHITELIST_openembedded-layer = "\
    atop \
    augeas \
    bonnie++ \
    bash-completion \
    canutils \
    cfengine \
    cfengine-masterfiles \
    collectd \
    cppzmq \
    crash \
    cryptsetup \
    ctdb \
    daq \
    dfu-util \
    dialog \
    edac-utils \
    efibootmgr \
    efivar \
    eject \
    eventlog \
    fbset \
    fbset-modes \
    fftw \
    fftwf \
    fftwl \
    freeglut \
    gd \
    gnome-doc-utils-stub \
    gnulib \
    gnuplot \
    gperftools \
    hostapd \
    htop \
    imagemagick \
    iotop \
    iozone3 \
    iperf \
    iperf3 \
    iw \
    krb5 \
    lcms \
    lemon \
    libcanberra \
    libconfig \
    libedit \
    libee \
    libestr \
    libgudev \
    libhugetlbfs \
    libldb \
    liblockfile \
    liblogging \
    liblognorm \
    libmcrypt \
    libmikmod \
    libmodbus \
    libnet \
    libsdl2-mixer \
    libsmi \
    libsodium \
    libsocketcan \
    libssh2 \
    libtdb \
    libtevent \
    libubox \
    libvpx \
    libx86 \
    libyaml \
    lmbench \
    lmsensors \
    lmsensors-config \
    lockfile-progs \
    ltrace \
    lua \
    lvm2 \
    mariadb \
    makedumpfile \
    mcelog \
    memstat \
    mercurial \
    minicoredumper \
    mysql-python \
    numactl \
    openldap \
    phoronix-test-suite \
    php \
    pps-tools \
    pmtools \
    postgresql \
    psqlodbc \
    python-pygobject \
    rfkill \
    rrdtool \
    rsnapshot \
    rsyslog \
    samba \
    sdparm \
    sg3-utils \
    smartmontools \
    syslog-ng \
    talloc \
    thin-provisioning-tools \
    tipcutils \
    ttf-liberation-sans-narrow \
    ttf-vlgothic \
    ttf-wqy-zenhei \
    unixodbc \
    usleep \
    uw-imap \
    vim \
    vim-tiny \
    vte9 \
    wipe \
    xerces-c \
    xrdb \
    yajl \
    zeromq \
"

# Whitelist for meta-openembedded/meta-perl
PNWHITELIST_perl-layer = "\
    adduser \
    libauthen-sasl-perl \
    libcgi-perl \
    libdbi-perl \
    libdigest-hmac-perl \
    libdigest-sha1-perl \
    libio-socket-ssl-perl \
    libipc-signal-perl \
    libmime-types-perl \
    libnet-dns-perl \
    libnet-libidn-perl \
    libnet-ssleay-perl \
    libproc-waitstat-perl \
    libtext-iconv-perl \
    libxml-filter-buffertext-perl \
    libxml-libxml-perl \
    libxml-sax-writer-perl \
    mime-construct \
"

# Whitelist for meta-openembedded/meta-python
PNWHITELIST_meta-python = "\
    python-cmd2 \
    python-cython \
    python-dbus \
    python-decorator \
    python3-django \
    python-django \
    python-ldap \
    python-lxml \
    python-m2crypto \
    python-mccabe \
    python-mock \
    python-paste \
    python-pbr \
    python-pep8 \
    python-pip \
    python3-pip \
    python-prettytable \
    python-py \
    python-pyflakes \
    python-pygpgme \
    python-pyparsing \
    python-pyrex \
    python-pyserial \
    python-pytest \
    python-pytz \
    python-pyudev \
    python-six \
    python-slip-dbus \
    python-twisted \
    python-zopeinterface \
    python3-pyserial \
"

# Whitelist for meta-openembedded/meta-initramfs
PNWHITELIST_meta-initramfs = "\
    dracut \
    grubby \
"
```
