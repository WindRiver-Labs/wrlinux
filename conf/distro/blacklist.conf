## conf/distro/wrlinux-common.inc
```bitbake
#
# Copyright (C) 2012 - 2015 Wind River Systems, Inc.
#
# information common to all wrlinux distros
#

MAINTAINER = "Wind River <info@windriver.com>"

TARGET_VENDOR = "-wrs"

LOCALCONF_VERSION = "1"

SDK_NAME = "${DISTRO}-${TCLIBC}-${SDK_ARCH}-${TARGET_ARCH}"
SDKPATH = "/opt/windriver/${DISTRO}/${SDK_VERSION}"
TCSDKMACH = "${@['', '_${SDK_OS}']['${SDK_OS}' != 'linux']}"
TOOLCHAIN_OUTPUTNAME = "${DISTRO}-${DISTRO_VERSION}-${TCLIBC}-${SDK_ARCH}${TCSDKMACH}-${MACHINE_ARCH}-${PN}-sdk"
TOOLCHAINEXT_OUTPUTNAME = "${DISTRO}-${DISTRO_VERSION}-${TCLIBC}-${SDK_ARCH}${TCSDKMACH}-${MACHINE_ARCH}-${PN}-sdk-ext"

TOOLCHAIN_OUTPUTNAME_pn-buildtools-tarball_forcevariable = "${SDK_ARCH}-buildtools-nativesdk-standalone-${DISTRO_VERSION}"

# Workaround for extensible SDK
TOOLCHAIN_OUTPUTNAME_pn-uninative-tarball = "${SDK_ARCH}-nativesdk-libc"

WRSDK_RDEPENDS ?= "\
        nativesdk-cmake \
        nativesdk-mtools \
        nativesdk-rpm-common \
        nativesdk-syslinux \
        nativesdk-unfs3 \
        nativesdk-util-linux \
"

# We must disable this for a mingw sdk!
WRSDK_RDEPENDS_sdkmingw32 = ""

# eSDk doesn't need extra TOOLCHAIN_HOST_TASK, eSDK ships
# buildtools-tarball which includes them.
WRSDK_RDEPENDS_task-populate-sdk-ext = ""

TOOLCHAIN_HOST_TASK_append = " ${WRSDK_RDEPENDS}"

# Add changelist.xml and fs_final*.sh processing
IMAGE_CLASSES += "image-fs_finalize"

# Override these in wrlinux based distros to modify DISTRO_EXTRA_R*
WRLINUX_DEFAULT_EXTRA_RDEPENDS = "packagegroup-core-boot"
WRLINUX_DEFAULT_EXTRA_RRECOMMENDS = "kernel-module-af-packet"

DISTRO_EXTRA_RDEPENDS += " ${WRLINUX_DEFAULT_EXTRA_RDEPENDS}"
DISTRO_EXTRA_RRECOMMENDS += " ${WRLINUX_DEFAULT_EXTRA_RRECOMMENDS}"

# do not include qemu-config by default
#WRLINUXQEMUDEPS = "${@bb.utils.contains("INCOMPATIBLE_LICENSE", "GPLv3", "", "qemu-config",d)}"
WRLINUXQEMUDEPS = ""

DISTRO_EXTRA_RDEPENDS_append_qemuarm = " ${WRLINUXQEMUDEPS}"
DISTRO_EXTRA_RDEPENDS_append_qemumips = " ${WRLINUXQEMUDEPS}"
DISTRO_EXTRA_RDEPENDS_append_qemuppc = " ${WRLINUXQEMUDEPS}"
DISTRO_EXTRA_RDEPENDS_append_qemux86 = " ${WRLINUXQEMUDEPS}"
DISTRO_EXTRA_RDEPENDS_append_qemux86-64 = " ${WRLINUXQEMUDEPS}"

TCLIBCAPPEND = ""

#default locale / local language processing settings
IMAGE_LINGUAS ?= ""

QEMU_TARGETS ?= "arm aarch64 i386 mips mipsel mips64 mips64el ppc ppc64 x86_64"
# Other QEMU_TARGETS "sh4"

MIRRORS =+ "\
ftp://.*/.*      http://downloads.yoctoproject.org/mirror/sources/ \n \
http://.*/.*     http://downloads.yoctoproject.org/mirror/sources/ \n \
https://.*/.*    http://downloads.yoctoproject.org/mirror/sources/ \n"

# The CONNECTIVITY_CHECK_URI's are used to test whether we can succesfully
# fetch from the network (and warn you if not). To disable the test set
# the variable to be empty.
CONNECTIVITY_CHECK_URIS ?= "https://www.example.com/"

# Default hash policy for distro
BB_SIGNATURE_HANDLER ?= 'OEBasicHash'

# Add our license to the acceptable restricted license list
LICENSE_FLAGS_WHITELIST += "commercial_windriver"

# QA check settings - a little stricter than the OE-Core defaults
WARN_TO_ERROR_QA = "already-stripped compile-host-path install-host-path \
                    pn-overrides staticdev useless-rpaths"
WARN_QA_remove = "${WARN_TO_ERROR_QA}"
ERROR_QA_append = " ${WARN_TO_ERROR_QA}"

# Allow dangling .bbappends for now
BB_DANGLINGAPPENDS_WARNONLY = "1"

# Change base package dependency in -dbg packages from recommends to suggests
RRECOMMENDS_${PN}-dbg = ""
RSUGGESTS_${PN}-dbg = "${PN} (= ${EXTENDPKGV})"

# lsb distro adjust
require conf/distro/include/wrlinux-lsb-distro-adjust.inc

# Make sure DISTRO_FEATURES backfill has pulseaudio 
# this is a temporary fix until pulseaudio is fixed

DISTRO_FEATURES_BACKFILL_CONSIDERED += " pulseaudio"

# Multilib configuration
MULTILIBS ?= ""
require conf/multilib.conf

PACKAGECONFIG_pn-sysstat = "lm-sensors"

# we usually use gnutls as the default PACKAGECONFIG of wpa-supplicant, but its sub-packege gnutls-openssl
# is GPLv3, so need this check to switch to openssl if GLPv3 is blacklisted.
PACKAGECONFIG_pn-wpa-supplicant = "${@bb.utils.contains('INCOMPATIBLE_LICENSE', 'GPLv3', 'openssl', 'gnutls', d)}"

require conf/distro/include/wrlinux-distro-settings.conf

require conf/distro/include/wrlinux-uninative.inc

# Exclude download layers from eSDK.
SDK_LAYERS_EXCLUDE_PATTERN ?= ".*-dl$ .*-dl-2.2$"
```

## conf/distro/wrlinux-sato.conf
```bitbake
# includes standard DISTRO_FEATURES
#
require wrlinux.conf

# only for systems with graphics
#
DISTRO_FEATURES_append = " x11 opengl"
```

## conf/distro/wrlinux-small.conf
```bitbake
#
# Copyright (C) 2013 Wind River Systems, Inc.
#

require conf/distro/wrlinux.conf
DISTRO = "wrlinux-small"

VIRTUAL-RUNTIME_no-busybox = ""
VIRTUAL-RUNTIME_login_manager = "busybox"
VIRTUAL-RUNTIME_base-utils = "busybox"
```

## conf/distro/wrlinux-std-sato.conf
```bitbake
#
# Copyright (C) 2013 Wind River Systems, Inc.
#

require conf/distro/wrlinux.conf
DISTRO = "wrlinux-std-sato"

DISTRO_FEATURES_append = " x11 opengl"
```

## conf/distro/wrlinux-tiny.conf
```bitbake
#
# Copyright (C) 2013 Wind River Systems, Inc.
#
# Distribution definition for: wrlinux-tiny
#
# wrlinux-tiny is intended to define a tiny Linux system comprised of a
# Linux kernel tailored to support each specific MACHINE and busybox.
# wrlinux-tiny sets some basic policy to ensure a usable system while still
# keeping the rootfs and kernel image as small as possible.
#
# The policies defined are intended to meet the following goals:
# o Serial consoles only (no framebuffer or VGA console)
# o Basic support for IPV4 networking
# o Single user ash shell
# o Static images (no support for adding packages or libraries later)
# o Read-only or RAMFS root filesystem
# o Combined Linux kernel + rootfs in under 4MB
#

require conf/distro/wrlinux.conf
DISTRO = "wrlinux-tiny"

# Distro config is evaluated after the machine config, so we have to explicitly
# set the kernel provider to override a machine config.
#PREFERRED_PROVIDER_virtual/kernel = "linux-windriver-tiny"

# We can use packagegroup-core-boot, but in the future we may need a new packagegroup-core-tiny
#WRLINUX_DEFAULT_EXTRA_RDEPENDS += "packagegroup-core-boot"
# Drop kernel-module-af-packet from RRECOMMENDS
WRLINUX_DEFAULT_EXTRA_RRECOMMENDS = ""

TCLIBCAPPEND = ""

# Disable wide char support for ncurses as we don't include it in
# in the LIBC features below.
ENABLE_WIDEC="false"

# Drop native language support. This removes the
# eglibc->bash->gettext->libc-posix-clang-wchar dependency.
USE_NLS="no"

# -dev packages require pkgconfig, but it pulls in glib->dbus->shadow
# which breaks with tiny's minimal libc.
# -dev packages are not currently supported on wrlinux-tiny.
ASSUME_PROVIDED += "pkgconfig$"

# Reconfigure eglibc for a smaller installation
# Comment out any of the lines below to disable them in the build
DISTRO_FEATURES_LIBC_TINY = "libc-libm libc-crypt"
DISTRO_FEATURES_LIBC_TINY_append_x86-64 = " libc-libm-big"

# Required for "who"
DISTRO_FEATURES_LIBC_MINIMAL = "libc-utmpx libc-getlogin"
DISTRO_FEATURES_LIBC_REGEX = "libc-posix-regexp"
DISTRO_FEATURES_LIBC_NET = "libc-inet libc-nis"

DISTRO_FEATURES_LIBC = "${DISTRO_FEATURES_LIBC_TINY} \
                        ${DISTRO_FEATURES_LIBC_MINIMAL} \
                        ${DISTRO_FEATURES_LIBC_REGEX} \
                        ${DISTRO_FEATURES_LIBC_NET} \
                       "

# Comment out any of the lines below to disable them in the build
# DISTRO_FEATURES options:
# alsa bluetooth ext2 irda pcmcia usbgadget usbhost wifi nfs zeroconf pci
DISTRO_FEATURES_TINY = "pci"
DISTRO_FEATURES_NET = "ipv4"
DISTRO_FEATURES_USB = "usbhost"
#DISTRO_FEATURES_USBGADGET = "usbgadget"
DISTRO_FEATURES_WIFI = "wifi"

DISTRO_FEATURES = "${DISTRO_FEATURES_TINY} \
                   ${DISTRO_FEATURES_NET} \
                   ${DISTRO_FEATURES_USB} \
                   ${DISTRO_FEATURES_USBGADGET} \
                   ${DISTRO_FEATURES_WIFI} \
                   ${DISTRO_FEATURES_LIBC} \
                  "

# Use tmpdevfs and the busybox runtime services
VIRTUAL-RUNTIME_dev_manager = ""
VIRTUAL-RUNTIME_login_manager = ""
VIRTUAL-RUNTIME_init_manager = "tiny-init"
VIRTUAL-RUNTIME_keymaps = ""

# FIXME: Consider adding "modules" to MACHINE_FEATURES and using that in
# packagegroup-core-base to select modutils-initscripts or not.  Similar with "net" and
# netbase.

# By default we only support initramfs and tar.bz2. We don't build live as that
# pulls in a lot of dependencies for the live image and the installer, like
# udev, grub, etc.  These pull in gettext, which fails to build with wide
# character support. 
IMAGE_FSTYPES += "cpio.gz tar.bz2"

# Drop v86d from qemu dependency list (we support serial)
# Drop grub from meta-intel BSPs
# FIXME: A different mechanism is needed here. We could define -tiny
#        variants of all compatible machines, but that leads to a lot
#        more machine configs to maintain long term.
MACHINE_ESSENTIAL_EXTRA_RDEPENDS = ""

# The mtrace script included by eglibc is a perl script. This means the system
# will build perl in case this package is installed. Since we don't care about
# this script for the purposes of tiny, remove the dependency from here.
RDEPENDS_${PN}-mtrace_pn-eglibc = ""

INHERIT += "blacklist"
PNBLACKLIST[build-appliance-image] = "not buildable with wrlinux-tiny"
PNBLACKLIST[core-image-base] = "not buildable with wrlinux-tiny"
PNBLACKLIST[core-image-basic] = "not buildable with wrlinux-tiny"
PNBLACKLIST[core-image-clutter] = "not buildable with wrlinux-tiny"
PNBLACKLIST[core-image-directfb] = "not buildable with wrlinux-tiny"
PNBLACKLIST[core-image-lsb] = "not buildable with wrlinux-tiny"
PNBLACKLIST[core-image-lsb-dev] = "not buildable with wrlinux-tiny"
PNBLACKLIST[core-image-lsb-sdk] = "not buildable with wrlinux-tiny"
PNBLACKLIST[core-image-rt] = "not buildable with wrlinux-tiny"
PNBLACKLIST[core-image-rt-sdk] = "not buildable with wrlinux-tiny"
PNBLACKLIST[core-image-sato] = "not buildable with wrlinux-tiny"
PNBLACKLIST[core-image-sato-dev] = "not buildable with wrlinux-tiny"
PNBLACKLIST[core-image-sato-sdk] = "not buildable with wrlinux-tiny"
PNBLACKLIST[core-image-x11] = "not buildable with wrlinux-tiny"
PNBLACKLIST[qt4e-demo-image] = "not buildable with wrlinux-tiny"
PNBLACKLIST[core-image-weston] = "not buildable with wrlinux-tiny"
PNBLACKLIST[wrlinux-image-glibc-small] = "not buildable with wrlinux-tiny"
PNBLACKLIST[wrlinux-image-glibc-core] = "not buildable with wrlinux-tiny"
PNBLACKLIST[wrlinux-image-glibc-std] = "not buildable with wrlinux-tiny"
PNBLACKLIST[wrlinux-image-glibc-std-sato] = "not buildable with wrlinux-tiny"

# Disable python usage in opkg-utils since it won't build with tiny config
PACKAGECONFIG_pn-opkg-utils = ""
PACKAGECONFIG_pn-lib32-opkg-utils = ""
```

## conf/distro/wrlinux.conf
```bitbake
#
# Copyright (C) 2013-2015 Wind River Systems, Inc.
#
DISTRO_NAME = "Wind River Linux"
SDK_VENDOR = "-wrlinuxsdk"
WRLINUX_VERSION = "9.0"

SDK_VERSION := "${WRLINUX_VERSION}"
WRLINUX_RCPLVERSION ?= ".0"
WRLINUX_EXTRAVERSION ?= ".0${WRLINUX_RCPLVERSION}"
DISTRO_VERSION = "${WRLINUX_VERSION}${WRLINUX_EXTRAVERSION}"
# When the DISTRO_VERSION contains DATE the following must be used
DISTRO_VERSION[vardepsexclude] += "DATE"

# If you're using glibc-std-sato, DISTRO will be wrlinux-std-sato.
# osv-wrlinux is used for settings we want across our whole product,
# not just in a specific distro.
DISTROOVERRIDES_append = "${@['', ':'][(d.getVar('DISTRO', True) != '')]}osv-wrlinux"

# Use -O0 for debugging; preserve all debug types
DEBUG_FLAGS_osv-wrlinux = "-g"
DEBUG_OPTIMIZATION_osv-wrlinux = "-O -fno-omit-frame-pointer ${DEBUG_FLAGS} -pipe"

# Add profiling optimization type
PROFILING_OPTIMIZATION = "${FULL_OPTIMIZATION} -fno-omit-frame-pointer -fvisibility=default"
SELECTED_OPTIMIZATION[vardeps] += "PROFILING_OPTIMIZATION"

# wrlinux specific versions to avoid -fpermissive in bitbake.conf
BUILD_CXXFLAGS_osv-wrlinux = "${BUILD_CFLAGS}"
TARGET_CXXFLAGS_osv-wrlinux = "${TARGET_CFLAGS}"

# we want to use rsyslog as the default syslog, but it's GPLv3, so need this
# check to switch to sysklogd if GLPv3 is blacklisted.
VIRTUAL-RUNTIME_syslog ?= "${@bb.utils.contains('INCOMPATIBLE_LICENSE', 'GPLv3', 'sysklogd', 'rsyslog', d)}"

# common wrlinux distro definitions
#
require wrlinux-common.inc

# override value set in default-distrovars.inc which are --
#
#DISTRO_FEATURES = "alsa argp bluetooth ext2 irda largefile \
#                    pcmcia usbgadget usbhost wifi xattr nfs \
#                    zeroconf pci 3g x11 ${DISTRO_FEATURES_LIBC}"
#
DISTRO_FEATURES ?= "\
        alsa \
        argp \
        bluetooth \
        ext2 \
        irda \
        largefile \
        nfs \
        pam \
        pcmcia \
        pci \
        pulseaudio \
        usbgadget \
        usbhost \
        wifi \
        xattr \
        ${DISTRO_FEATURES_LIBC} \
        multiarch \
"

# Workaround for native packages depending on DISTRO_FEATURES in 1.5
# Create a fixed list of distro features for all native packages
# so that the sstate can be shared. This is the union of all
# DISTRO_FEATURES for glibc-tiny, core, small, std and std-sato.
# I used DISTRO_FEATURES_LIBC_DEFAULT because glibc-tiny
# changes the DISTRO_FEATURES_LIBC
DISTRO_FEATURES_class-native_forcevariable="\
        alsa \
        argp \
        bluetooth \
        ext2 \
        irda \
        largefile \
        nfs \
        pam \
        pcmcia \
        pci \
        pulseaudio \
        usbgadget \
        usbhost \
        wifi \
        sysvinit \
        x11 \
        opengl \
        ${DISTRO_FEATURES_LIBC_DEFAULT}"

# Native sstate should not depend on multilib provider whitelist
MULTI_PROVIDER_WHITELIST_class-native_forcevariable=""

# Disable trying to run ldconfig as a package post install rule
USE_LDCONFIG ?= "0"
# As ldconfig is missing on target, disable the corresponding PACKAGECONFIG for systemd
PACKAGECONFIG_remove_pn-systemd = "${@['ldconfig', ''][int(d.getVar('USE_LDCONFIG', True))]}"

# Configure the root user's home directory
ROOT_HOME ?= "/root"

# initramfs image for wrlinux distro
INITRD_IMAGE_LIVE ?= "wrlinux-image-minimal-initramfs"

# The providers are fftwf, fftwl, fftw
PREFERRED_PROVIDER_virtual/fftw = "fftw"

# Set the default psplash from psplash-default to psplash-windriver
SPLASH = "psplash-windriver"

# Possibly eliminate busybox from an image.  The variables defined here
# are used by oe-core packagegroup-core-boot.bb.  The overrides are
# DISTRO names.

VIRTUAL-RUNTIME_login_manager = "shadow"
VIRTUAL-RUNTIME_login_manager_wrlinux-tiny = "busybox"
VIRTUAL-RUNTIME_login_manager_wrlinux-small = "busybox"

# We assume that we provide base-utils.  This variable must
# empty or one item.
#
VIRTUAL-RUNTIME_base-utils = ""
VIRTUAL-RUNTIME_base-utils_wrlinux-tiny = "busybox"
VIRTUAL-RUNTIME_base-utils_wrlinux-small = "busybox"

# This runs the busybox-hwclock script during systemv
# init.  This does NOT supply /sbin/hwclock, only a script!
#
VIRTUAL-RUNTIME_base-utils-hwclock = "busybox-hwclock"

# Supply replacements for busybox functions we really, really need.
#
VIRTUAL-RUNTIME_no-busybox = "dpkg-start-stop"
VIRTUAL-RUNTIME_no-busybox_wrlinux-tiny = ""
VIRTUAL-RUNTIME_no-busybox_wrlinux-small = ""

IMAGE_INSTALL_append = " ${VIRTUAL-RUNTIME_no-busybox}"
```
