## conf/layer.conf
```bitbake
#
# Copyright (C) 2013-2017 Wind River Systems, Inc.
#
# We have a conf and classes directory, add to BBPATH
BBPATH =. "${LAYERDIR}:"

# We have a packages directory, add to BBFILES
BBFILES += "${LAYERDIR}/recipes-*/*/*.bb \
	${LAYERDIR}/recipes-*/*/*.bbappend"

# Active some changes dynamically based on layer inclusion
BBFILES_DYNAMIC += "gnome-layer:${LAYERDIR}/dynamic-layers/gnome-layer/recipes*/*/*.bb \
                    gnome-layer:${LAYERDIR}/dynamic-layers/gnome-layer/recipes*/*/*.bbappend \
                    networking-layer:${LAYERDIR}/dynamic-layers/networking-layer/recipes*/*/*.bb \
                    networking-layer:${LAYERDIR}/dynamic-layers/networking-layer/recipes*/*/*.bbappend \
                    openembedded-layer:${LAYERDIR}/dynamic-layers/openembedded-layer/recipes*/*/*.bb \
                    openembedded-layer:${LAYERDIR}/dynamic-layers/openembedded-layer/recipes*/*/*.bbappend \
                    webserver:${LAYERDIR}/dynamic-layers/webserver/recipes*/*/*.bb \
                    webserver:${LAYERDIR}/dynamic-layers/webserver/recipes*/*/*.bbappend \
                    xfce-layer:${LAYERDIR}/dynamic-layers/xfce-layer/recipes*/*/*.bb \
                    xfce-layer:${LAYERDIR}/dynamic-layers/xfce-layer/recipes*/*/*.bbappend \
                    meta-anaconda:${LAYERDIR}/dynamic-layers/meta-anaconda/recipes*/*/*.bb \
                    meta-anaconda:${LAYERDIR}/dynamic-layers/meta-anaconda/recipes*/*/*.bbappend \
                    secure-core:${LAYERDIR}/dynamic-layers/secure-core/recipes*/*/*.bb \
                    secure-core:${LAYERDIR}/dynamic-layers/secure-core/recipes*/*/*.bbappend \
                    encrypted-storage:${LAYERDIR}/dynamic-layers/encrypted-storage/recipes*/*/*.bb \
                    encrypted-storage:${LAYERDIR}/dynamic-layers/encrypted-storage/recipes*/*/*.bbappend \
                    dpdk:${LAYERDIR}/dynamic-layers/dpdk/recipes*/*/*.bb \
                    dpdk:${LAYERDIR}/dynamic-layers/dpdk/recipes*/*/*.bbappend \
                   "

BBFILE_COLLECTIONS += "wrlinux"
BBFILE_PATTERN_wrlinux = "^${LAYERDIR}/(?!wrlinux-cgl|wrlinux-distro|wrlinux-ovp)"
BBFILE_PRIORITY_wrlinux = "6"

# Add scripts to PATH
PATH .= ":${LAYERDIR}/scripts"

LAYER_PATH_wrlinux = "${LAYERDIR}"

# We have a LICENSE_DIR to search for additional licenses
WR_EXTRA_LIC_DIR = "${LAYERDIR}/files/common-licenses"
LICENSE_PATH[vardepsexclude] += "WR_EXTRA_LIC_DIR"
LICENSE_PATH += "${WR_EXTRA_LIC_DIR}"

# This should only be incremented on significant changes that will
# cause compatibility issues with other layers
LAYERVERSION_wrlinux = "2"

LAYERSERIES_COMPAT_wrlinux = "thud wrl"

LAYERDEPENDS_wrlinux = " \
	core \
	wr-template \
	"

LAYERRECOMMENDS_wrlinux = " \
	gnome-layer \
	networking-layer \
	filesystems-layer \
	openembedded-layer \
	webserver \
	xfce-layer \
	virtualization-layer \
	realtime \
	wrlinux-dl \
	dpdk \
	meta-anaconda \
	"

# Enable system wide wrlinux/blacklist behavior
require wrlinux-version.inc
require wrlinux-blacklist.conf
require wrlinux-whitelist.conf
require wrlinux-exclude-from-world.conf

BB_HASHBASE_WHITELIST_append = " LAYER_PATH_wrlinux"
```

## conf/machine/qemuarma9.conf
```bitbake
# qemuarma9 is no longer supported, this is simply a compatibility shim to
# the a15 version.  These are compatible from a userspace perspective.

# The historical qemuarma9 is based on the arm versatile hardware emulation,
# but the point of our QEMU architectures is not platform emulation but
# ability for overall system simulation, and with a focus on userspace
# testing.  The qemuarm uses the generic '-machine virt' instead, which is
# more efficient than the versatile BSP.

CONFIG_BANNER[machine_qemuarma9] = "qemuarma9 is no longer supported, using qemuarm instead."

MACHINE = "qemuarm"

require conf/machine/${MACHINE}.conf
```

## wrlinux-cgl/conf/distro/include/security_flags_wrs_cgl.inc
```bitbake
SECURITY_CFLAGS_pn-cgl-unittest = "${SECURITY_NOPIE_CFLAGS}"
SECURITY_CFLAGS_pn-gen-coredump = "${SECURITY_NOPIE_CFLAGS}"
```

## wrlinux-cgl/conf/distro/include/wrlinux-cgl-whitelist.inc
```bitbake
#
# Copyright (C) 2016 - 2017 Wind River Systems, Inc.
#
# Explicitly allow these recipes in wrlinux cgl
#

# Whitelist the whole wrlinux-cgl layer
PNWHITELIST_LAYERS_remove = "wrlinux-cgl"

# Enable items for wrlinux-cgl distro
#
# For meta-cgl/meta-cgl-common
PNWHITELIST_cgl-common_append = " \
    cluster-glue \
    crmsh \
    libhtml-tagset-perl \
    libmailtools-perl \
    libsocket6-perl \
    libtest-pod-perl \
    libwww-perl \
    monit \
    ocfs2-tools \
    pacemaker \
    resource-agents \
    ucarp \
"

# For meta-openembedded/meta-python
PNWHITELIST_meta-python_append = " \
    python-cffi \
    python-lxml \
    python-paste \
    python-ply \
    python-pyasn1 \
    python-pycparser \
    python-six \
    python-vcversioner \
"

# For meta-openembedded/meta-networking
PNWHITELIST_networking-layer_append = " \
    bridge-utils \
    c-ares \
    corosync \
    freediameter \
    geoip \
    geoip-perl \
    ifenslave \
    inetutils \
    ippool \
    ipvsadm \
    iscsi-initiator-utils \
    libldb \
    libtdb \
    libtevent \
    lksctp-tools \
    netkit-rsh \
    netkit-telnet \
    ntop \
    ntp \
    openhpi \
    openipmi \
    open-isns \
    openl2tp \
    quagga \
    rdate \
    rdist \
    samba \
    strongswan \
    tftp-hpa \
    tnftp \
    traceroute \
    tunctl \
    vblade \
    vlan \
    vsftpd \
"

# For meta-openembedded/meta-oe
PNWHITELIST_openembedded-layer_append = " \
    crash \
    edac-utils \
    indent \
    ipmitool \
    libnet \
    libqb \
    numactl \
    postgresql \
    pps-tools \
    python-pygobject \
    smartmontools \
"

# For meta-openembedded/meta-perl
PNWHITELIST_perl-layer_append = " \
    libauthen-sasl-perl \
    libdigest-hmac-perl \
    libdigest-sha1-perl \
    libhtml-parser-perl \
    libio-socket-ssl-perl \
    libnet-dns-perl \
    libnet-libidn-perl \
    libnet-ssleay-perl \
    libnet-telnet-perl \
    libtext-iconv-perl \
    libxml-filter-buffertext-perl \
    libxml-libxml-perl \
    libxml-sax-writer-perl \
"

# For meta-virtualization
PNWHITELIST_virtualization-layer_append = " \
    lxc \
"
```

## wrlinux-cgl/conf/distro/wrlinux-cgl.conf
```bitbake
# Copyright (C) 2017 Wind River Systems, Inc.
#
# information common to wrlinux-cgl distro
#

#@TYPE: Distro
#@NAME: Wind River Linux CGL
#@DESCRIPTION: Wind River Linux (Carrier Grade Linux distribution)

require conf/distro/wrlinux.conf

WRLINUX_VARIANT = " CGL"

WRLINUX_DEFAULT_DISTRO_FEATURES += "cgl"
```

## wrlinux-cgl/conf/layer.conf
```bitbake
#
# Copyright (C) 2013-2017 Wind River Systems, Inc.
#
# We have a conf and classes directory, add to BBPATH
BBPATH =. "${LAYERDIR}:"

# We have a packages directory, add to BBFILES
BBFILES += "${LAYERDIR}/recipes-*/*/*.bb \
        ${LAYERDIR}/recipes-*/*/*.bbappend"

BBFILE_COLLECTIONS += "wrlinux-cgl"
BBFILE_PATTERN_wrlinux-cgl := "^${LAYERDIR}/"
BBFILE_PRIORITY_wrlinux-cgl = "8"

# This should only be incremented on significant changes that will
# cause compatibility issues with other layers
LAYERVERSION_wrlinux-cgl = "1"

LAYERSERIES_COMPAT_wrlinux-cgl = "thud wrl warrior"

LAYERDEPENDS_wrlinux-cgl = " \
	cgl-common \
	openstack-layer \
	core \
	selinux \
	security \
        filesystems-layer \
        gnome-layer \
        meta-initramfs \
        multimedia-layer \
        networking-layer \
        openembedded-layer \
        perl-layer \
        meta-python \
        webserver \
        xfce-layer \
        virtualization-layer \
        realtime \
	wrlinux \
	wrlinux-distro \
	wr-template \
	"

LAYERRECOMMENDS_wrlinux-cgl = "wrlinux-cgl-dl"

TEMPLATES_PATH = "${LAYERDIR}/templates"
```

## wrlinux-distro/conf/distro/include/wrlinux-base-whitelist.inc
```bitbake
# This file controls the list of supported items when the wrlinux and related
# distributions are enabled.  Please keep the lists below sorted.

# Whitelist the whole wrlinux-distro layer
PNWHITELIST_LAYERS_remove = "wrlinux-distro"

# Define supported items from meta-openembedded
PNWHITELIST_filesystems-layer += ""

PNWHITELIST_meta-initramfs += ""
PNWHITELIST_multimedia-layer += ""

PNWHITELIST_networking-layer += " \
    freeradius \
    libtalloc \
    netcat \
    netcat-openbsd \
    postfix \
    tcpdump \
    crda \
    strongswan \
"

PNWHITELIST_openembedded-layer += " \
    agent-proxy-native \
    bonnie++ \
    fbset \
    fbset-modes \
    iotop \
    krb5 \
    lemon-native \
    libdbd-mysql-perl \
    libdbi-perl \
    libdev-checklib-perl \
    liblockfile \
    libmcrypt \
    lockfile-progs \
    mailx \
    mariadb \
    memstat \
    nmap \
    passwdqc \
    phoronix-test-suite \
    php \
    pmtools \
    postgresql \
    rfkill \
    sdparm \
    sg3-utils \
    syslog-ng \
    tclap \
    unixodbc \
    usleep \
    uw-imap \
    vlock \
    iperf3 \
    xmlsec1 \
"

PNWHITELIST_perl-layer += " \
    adduser \
    libipc-signal-perl \
    libmime-types-perl \
    libproc-waitstat-perl \
    logcheck \
    mime-construct \
"

PNWHITELIST_meta-python += " \
    python-dbus \
    python-pyrex-native \
    python3-django \
    python3-django-south \
    python3-pytz \
    nativesdk-python3-beautifulsoup4 \
    nativesdk-python3-pytz \
    python-m2crypto \
    python-typing \
    python3-pyyaml \
    python3-jinja2 \
    python3-markupsafe \
    python3-cython \
    python3-sqlparse \
"

PNWHITELIST_webserver += " \
    phpmyadmin \
    xdebug \
"

PNWHITELIST_xfce-layer += ""

PNWHITELIST_security += " \
    ecryptfs-utils \
    libgssglue \
    libmhash \
    samhain-client \
    samhain-server \
    samhain-standalone \
"

PNWHITELIST_integrity += " \
    ima-inspect \
    ima-evm-utils \
"

# Workaround for nmap possibly requiring python-pygtk which is not available
PACKAGECONFIG_remove_pn-nmap = "zenmap"

PNWHITELIST_selinux += " \
    audit \
"

PNWHITELIST_scanners-layer += " \
    openscap \
    scap-security-guide \
"
```

## wrlinux-distro/conf/distro/include/wrlinux-bsp-qemuarm64.inc
```bitbake
MULTILIBS ?= "multilib:lib32"
DEFAULTTUNE_virtclass-multilib-lib32 ?= "armv7vethf"
```
