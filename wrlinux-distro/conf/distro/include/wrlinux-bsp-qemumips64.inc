## wrlinux-distro/conf/distro/wrlinux-tiny.conf
```bitbake
#
# Copyright (C) 2013-2019 Wind River Systems, Inc.
# All rights reserved.
#
# Distribution definition for: wrlinux-tiny

#@TYPE: Distro
#@NAME: Wind River Linux Tiny
#@DESCRIPTION: Wind River Linux (Example minimal distribution, will require customization)

# wrlinux-tiny is intended to define a tiny Linux system comprised of a
# Linux kernel tailored to support each specific MACHINE and busybox.
# wrlinux-tiny sets some basic policy to ensure a usable system while still
# keeping the rootfs and kernel image as small as possible.
#
# The policies defined are intended to meet the following goals:
# o Serial consoles only (no framebuffer or VGA console)
# o Basic support for IPV4 networking
# o Single user ash shell
# o Static images (no support for adding packages or libraries later)
# o Read-only or RAMFS root filesystem
# o Combined Linux kernel + rootfs in under 4MB
#

WRLINUX_VARIANT = "tiny"

require conf/distro/wrlinux.conf

# Distro config is evaluated after the machine config, so we have to explicitly
# set the kernel provider to override a machine config.
PREFERRED_PROVIDER_virtual/kernel = "linux-yocto-tiny"
PREFERRED_VERSION_linux-yocto-tiny ?= "4.18%"

# We can use packagegroup-core-boot, but in the future we may need a new packagegroup-core-tiny
#WRLINUX_DEFAULT_EXTRA_RDEPENDS += "packagegroup-core-boot"
# Drop kernel-module-af-packet from RRECOMMENDS
WRLINUX_DEFAULT_EXTRA_RRECOMMENDS = ""

# Drop native language support. This removes the
# glibc->bash->gettext->libc-posix-clang-wchar dependency.
USE_NLS="no"

# -dev packages require pkgconfig, but it pulls in glib->dbus->shadow
# which breaks with tiny's minimal libc.
# -dev packages are not currently supported on wrlinux-tiny.
ASSUME_PROVIDED += "pkgconfig$"

# Comment out any of the lines below to disable them in the build
# DISTRO_FEATURES options:
# alsa bluetooth ext2 irda pcmcia usbgadget usbhost wifi nfs zeroconf pci
DISTRO_FEATURES_TINY = "pci"
DISTRO_FEATURES_NET = "ipv4 ipv6"
DISTRO_FEATURES_USB = "usbhost"
#DISTRO_FEATURES_USBGADGET = "usbgadget"
DISTRO_FEATURES_WIFI = "wifi"

DISTRO_FEATURES = "${DISTRO_FEATURES_TINY} \
                   ${DISTRO_FEATURES_NET} \
                   ${DISTRO_FEATURES_USB} \
                   ${DISTRO_FEATURES_USBGADGET} \
                   ${DISTRO_FEATURES_WIFI} \
                  "

# Enable LFS - see bug YOCTO #5865
DISTRO_FEATURES_append_libc-musl = " largefile"

# From poky:
WRLINUX_DEFAULT_DISTRO_FEATURES = "largefile opengl ptest multiarch wayland vulkan"

DISTRO_FEATURES_class-native = "${DISTRO_FEATURES_DEFAULT} ${WRLINUX_DEFAULT_DISTRO_FEATURES}"
DISTRO_FEATURES_class-nativesdk = "${DISTRO_FEATURES_DEFAULT} ${WRLINUX_DEFAULT_DISTRO_FEATURES}"

# enable mdev/busybox for init
VIRTUAL-RUNTIME_dev_manager = "busybox-mdev"
VIRTUAL-RUNTIME_login_manager = "busybox"
VIRTUAL-RUNTIME_init_manager = "busybox"
VIRTUAL-RUNTIME_initscripts = "initscripts"
VIRTUAL-RUNTIME_keymaps = "keymaps"
DISTRO_FEATURES_BACKFILL_CONSIDERED += "sysvinit"
VIRTUAL-RUNTIME_no-busybox = ""

# FIXME: Consider adding "modules" to MACHINE_FEATURES and using that in
# packagegroup-core-base to select modutils-initscripts or not.  Similar with "net" and
# netbase.

# By default we only support initramfs and tar.bz2. We don't build live as that
# pulls in a lot of dependencies for the live image and the installer, like
# udev, grub, etc.  These pull in gettext, which fails to build with wide
# character support. 
IMAGE_FSTYPES += "cpio.gz tar.bz2"

# Drop v86d from qemu dependency list (we support serial)
# Drop grub from meta-intel BSPs
# FIXME: A different mechanism is needed here. We could define -tiny
#        variants of all compatible machines, but that leads to a lot
#        more machine configs to maintain long term.
MACHINE_ESSENTIAL_EXTRA_RDEPENDS = ""

# The mtrace script included by glibc is a perl script. This means the system
# will build perl in case this package is installed. Since we don't care about
# this script for the purposes of tiny, remove the dependency from here.
RDEPENDS_${PN}-mtrace_pn-glibc = ""

INHERIT += "blacklist"
PNBLACKLIST[build-appliance-image] = "not buildable with wrlinux-tiny"
PNBLACKLIST[core-image-base] = "not buildable with wrlinux-tiny"
PNBLACKLIST[core-image-clutter] = "not buildable with wrlinux-tiny"
PNBLACKLIST[core-image-full-cmdline] = "not buildable with wrlinux-tiny"
PNBLACKLIST[core-image-lsb] = "not buildable with wrlinux-tiny"
PNBLACKLIST[core-image-lsb-dev] = "not buildable with wrlinux-tiny"
PNBLACKLIST[core-image-lsb-sdk] = "not buildable with wrlinux-tiny"
PNBLACKLIST[core-image-rt] = "not buildable with wrlinux-tiny"
PNBLACKLIST[core-image-rt-sdk] = "not buildable with wrlinux-tiny"
PNBLACKLIST[core-image-sato] = "not buildable with wrlinux-tiny"
PNBLACKLIST[core-image-sato-dev] = "not buildable with wrlinux-tiny"
PNBLACKLIST[core-image-sato-sdk] = "not buildable with wrlinux-tiny"
PNBLACKLIST[core-image-x11] = "not buildable with wrlinux-tiny"
PNBLACKLIST[core-image-weston] = "not buildable with wrlinux-tiny"
PNBLACKLIST[wrlinux-image-glibc-small] = "not buildable with wrlinux-tiny"
PNBLACKLIST[wrlinux-image-glibc-core] = "not buildable with wrlinux-tiny"
PNBLACKLIST[wrlinux-image-glibc-std] = "not buildable with wrlinux-tiny"
PNBLACKLIST[wrlinux-image-glibc-std-sato] = "not buildable with wrlinux-tiny"
PNBLACKLIST[wrlinux-image-glibc-cgl] = "not buildable with wrlinux-tiny"

# Disable python usage in opkg-utils since it won't build with tiny config
PACKAGECONFIG_pn-opkg-utils = "update-alternatives"
PACKAGECONFIG_pn-lib32-opkg-utils = "update-alternatives"

TEMPLATES_PATH = "${LAYER_PATH_wrlinux}/wrlinux-distro/templates"
WRTEMPLATE_append = " feature/posix-timers"
```

## wrlinux-distro/conf/distro/wrlinux.conf
```bitbake
#
# Copyright (C) 2013-2020 Wind River Systems, Inc.
#
# This file is probably included by all the other wrlinux distro conf's.
#

#@TYPE: Distro
#@NAME: Wind River Linux
#@DESCRIPTION: Wind River Linux (Full Featured Distribution)

# Add profiling optimization type
PROFILING_OPTIMIZATION = "${FULL_OPTIMIZATION} -fno-omit-frame-pointer -fvisibility=default"
SELECTED_OPTIMIZATION[vardeps] += "PROFILING_OPTIMIZATION"

# Some packages have problems with PROFILING_OPTIMIZATION
#
# fix linking/relocating error
PROFILING_OPTIMIZATION_remove_pn-llvm_powerpc = "-fno-omit-frame-pointer"
# fix error: r7 cannot be used in asm here
PROFILING_OPTIMIZATION_remove_pn-pulseaudio_arm = "-fno-omit-frame-pointer"
# gcc-sanitizers makes extensive use of hidden visibility and frame pointer omission.
# Trying to override that can cause build failures.
PROFILING_OPTIMIZATION_pn-gcc-sanitizers = "${FULL_OPTIMIZATION}"
# Fix traps: python[550] trap invalid opcode ip:b7f80f00 sp:bfb09a10 error:0 in ld-2.30.so[b7f7b000+1c000]
PROFILING_OPTIMIZATION_remove_pn-glibc_x86 = "-fno-omit-frame-pointer"

# we want to use rsyslog as the default syslog, but it's GPLv3, so need this
# check to switch to sysklogd if GLPv3 is blacklisted.
VIRTUAL-RUNTIME_syslog ?= "${@bb.utils.contains('INCOMPATIBLE_LICENSE', 'GPLv3', 'sysklogd', 'rsyslog', d)}"
VIRTUAL-RUNTIME_base-utils-syslog ?= "${VIRTUAL-RUNTIME_syslog}"


# common wrlinux distro definitions
#
require wrlinux-common.inc

# Add general dependency
DISTRO_FEATURES_DEFAULT_remove_class-target = "x11"
WRLINUX_DEFAULT_DISTRO_FEATURES += "pam"

# Native sstate should not depend on multilib provider whitelist
MULTI_PROVIDER_WHITELIST_class-native_forcevariable=""

# Configure the root user's home directory
ROOT_HOME ?= "/root"

# initramfs image for wrlinux distro
INITRD_IMAGE_LIVE ?= "${@d.getVar('INITRAMFS_IMAGE', True) if d.getVar('INITRAMFS_IMAGE', True) else 'wrlinux-image-minimal-initramfs'}"

# The providers are fftwf, fftwl, fftw
PREFERRED_PROVIDER_virtual/fftw = "fftw"

# Set the default psplash from psplash-default to psplash-windriver
SPLASH = "psplash-windriver"

## Syslinux options for boot menus when using isolinux or linux live
SYSLINUX_TIMEOUT = "50"
SYSLINUX_SPLASH = "${@oe.utils.conditional('WRLINUX_BRANCH', 'LTS', '${LAYER_PATH_wrlinux}/files/syslinux/bootloading-blue-wrl.png', '${LAYER_PATH_wrlinux}/files/syslinux/bootloading-gray-wrl.png', d)}"
AUTO_SYSLINUXMENU = "1"

## Have graphics and serial in the boot menu when use grub-efi in iso
GRUB_GFXSERIAL = "1"
GRUB_TIMEOUT = "5"

# Possibly eliminate busybox from an image.  The variables defined here
# are used by oe-core packagegroup-core-boot.bb.  The overrides are
# DISTRO names.
VIRTUAL-RUNTIME_login_manager = "shadow"

# We assume that we provide base-utils.  This variable must
# empty or one item.
#
VIRTUAL-RUNTIME_base-utils = ""

# This runs the busybox-hwclock script during systemv
# init.  This does NOT supply /sbin/hwclock, only a script!
#
VIRTUAL-RUNTIME_base-utils-hwclock = "busybox-hwclock"

# Supply replacements for busybox functions we really, really need.
#
VIRTUAL-RUNTIME_no-busybox = "packagegroup-busybox-replacement"

IMAGE_INSTALL_append = " ${VIRTUAL-RUNTIME_no-busybox}"

# Explicitly specify which kernel we use for CI
PREFERRED_PROVIDER_virtual/kernel ?= "linux-yocto"

INHERIT += "ext_secure_cflags wrlinux-metadata_scm"

require conf/distro/include/security_flags_wrs.inc

#set wrlinux network manager
NETWORK_MANAGER = "bind"

# Support distro features override, such as cgl
INHERIT += "distrooverrides"
DISTRO_FEATURES_OVERRIDES += "cgl"

# Support DISTRO_FEATURES(cgl)
require wrlinux-cgl/conf/distro_features/distro_feature_cgl.inc

# Define WR sample keys directory
WR_SAMPLE_KEYS_DIR ?= "${LAYER_PATH_wrlinux-distro}/files/sample-keys"

# By default the sample keys are used
WR_KEYS_DIR ?= "${WR_SAMPLE_KEYS_DIR}"

PREFERRED_VERSION_linux-yocto ?= "5.4%"
```

## wrlinux-distro/conf/layer.conf
```bitbake
#
# Copyright (C) 2013-2017 Wind River Systems, Inc.
#
# We have a conf and classes directory, add to BBPATH
BBPATH =. "${LAYERDIR}:"

BBFILES += "${LAYERDIR}/recipes-*/*/*.bb \
        ${LAYERDIR}/recipes-*/*/*.bbappend"

# Active some changes dynamically based on layer inclusion
BBFILES_DYNAMIC += "selinux:${LAYERDIR}/dynamic-layers/selinux/recipes*/*/*.bb \
                    selinux:${LAYERDIR}/dynamic-layers/selinux/recipes*/*/*.bbappend \
                    "

BBFILE_COLLECTIONS += "wrlinux-distro"
BBFILE_PATTERN_wrlinux-distro = "^${LAYERDIR}/"
BBFILE_PRIORITY_wrlinux-distro = "6"

LAYER_PATH_wrlinux-distro = "${LAYERDIR}"

# This should only be incremented on significant changes that will
# cause compatibility issues with other layers
LAYERVERSION_wrlinux-distro = "1"

LAYERSERIES_COMPAT_wrlinux-distro = "wrl dunfell gatesgarth"

LAYERDEPENDS_wrlinux-distro = " \
	core \
	wr-template \
	wrlinux \
	filesystems-layer \
	gnome-layer \
	meta-initramfs \
	multimedia-layer \
	networking-layer \
	openembedded-layer \
	perl-layer \
	meta-python \
	webserver \
	xfce-layer \
	virtualization-layer \
	realtime \
	cloud-services-layer \
	"

LAYERRECOMMENDS_wrlinux-distro = " \
	efi-secure-boot \
	encrypted-storage \
	ids \
	integrity \
	secure-core \
	signing-key \
	tpm \
	tpm2 \
	selinux \
	security \
	meta-anaconda \
	"
```

## wrlinux-kernel-dev/conf/layer.conf
```bitbake
#
# Copyright (C) 2013,2017 Wind River Systems, Inc.
#

# We have a conf and classes directory, add to BBPATH
BBPATH =. "${LAYERDIR}:"

# We have a packages directory, add to BBFILES
WKD_BBFILES = "${LAYERDIR}/recipes-*/*/*.bb \
        ${LAYERDIR}/recipes-*/*/*.bbappend"

# Only enable if ENABLE_KERNEL_DEV is set to 1
BBFILES += "${@'${WKD_BBFILES}' if d.getVar('ENABLE_KERNEL_DEV') == '1' else ''}"

BBFILE_PATTERN_IGNORE_EMPTY_kernel-dev = "${@'' if d.getVar('ENABLE_KERNEL_DEV') == '1' else '1'}"

BBFILE_COLLECTIONS += "kernel-dev"
BBFILE_PATTERN_kernel-dev = "^${LAYERDIR}/"
BBFILE_PRIORITY_kernel-dev = "6"

BB_ENV_EXTRAWHITE += "KSRC"

# This should only be incremented on significant changes that will
# cause compatibility issues with other layers
LAYERVERSION_kernel-dev = "1"

LAYERSERIES_COMPAT_kernel-dev = "sumo"

LAYERDEPENDS_kernel-dev = "core"

PNWHITELIST_kernel-dev += " \
    linux-yocto-custom \
"

# Sanity check for wrlinux-kernel-dev
# Setting SKIP_SANITY_BBAPPEND_CHECK to "1" would skip the bbappend files check
INHERIT += "sanity-wrlinux-kernel-dev"
```

## wrlinux-nxp-secureboot/conf/layer.conf
```bitbake
#
# Copyright (C) 2020 Wind River Systems, Inc.
#
#
# Permission is hereby granted, free of charge, to any person obtaining a copy
# of this software and associated documentation files (the "Software"), to deal
# in the Software without restriction, including without limitation the rights
# to use, copy, modify, merge, publish, distribute, sublicense, and/or sell
# copies of the Software, and to permit persons to whom the Software is
# furnished to do so, subject to the following conditions:
#
# The above copyright notice and this permission notice shall be included in
# all copies or substantial portions of the Software.
#
# THE SOFTWARE IS PROVIDED "AS IS", WITHOUT WARRANTY OF ANY KIND, EXPRESS OR
# IMPLIED, INCLUDING BUT NOT LIMITED TO THE WARRANTIES OF MERCHANTABILITY,
# FITNESS FOR A PARTICULAR PURPOSE AND NONINFRINGEMENT. IN NO EVENT SHALL THE
# AUTHORS OR COPYRIGHT HOLDERS BE LIABLE FOR ANY CLAIM, DAMAGES OR OTHER
# LIABILITY, WHETHER IN AN ACTION OF CONTRACT, TORT OR OTHERWISE, ARISING FROM,
# OUT OF OR IN CONNECTION WITH THE SOFTWARE OR THE USE OR OTHER DEALINGS IN
# THE SOFTWARE.

# We have a conf and classes directory, add to BBPATH
BBPATH .= ":${LAYERDIR}"

require ls-secure-boot.inc

# We have a packages directory, add to BBFILES
BBFILES += "${LAYERDIR}/recipes-*/*/*.bb \
	${LAYERDIR}/recipes-*/*/*.bbappend \
	${LAYERDIR}/classes/*.bbclass"

BBFILE_COLLECTIONS += "ls-secure-layer"
BBFILE_PATTERN_ls-secure-layer := "^${LAYERDIR}/"
BBFILE_PRIORITY_ls-secure-layer = "7"

INHERIT += "machine-overrides-extender"
MACHINEOVERRIDES_EXTENDER_nxp-ls1043 = "qoriq:qoriq-arm64:fsl-lsch2:ls1043a:ls1043ardb:fsl-qoriq"

INSECURE_KEY_MSG = "\
WARNING:\
1. The insecure sample keys are used for secure Boot. \
Please ensure that you are aware of what your risk to use these keys in your own product. \
2. The secure boot layer includes third party components, where additional third party software may apply. \
Please ensure that you are aware of the license limitation to use third party software in your own product.\
"

# Warn the user if sample key is used
BANNER[nxp-ls_default] = "${INSECURE_KEY_MSG}"

LAYERSERIES_COMPAT_ls-secure-layer = "wrl zeus"

LAYER_PATH_ls-secure-layer = "${LAYERDIR}"

LICENSE_PATH += "${LAYERDIR}/files/custom-licenses"
```

## wrlinux-nxp-secureboot/wic/nxp-ls1043-sdimage-secure-boot.wks
```
# short-description: Create a ls1043 disk image (SD card)
# long-description: Create a partitioned disk image for NXP ls1043
# The first partition is NULL, reserved for uboot.
# The second partition is to accommodate kernel, dtb and rootfs.

part u-boot --source rawcopy --sourceparams="file=firmware_ls1043ardb_uboot_sdboot_secure.img" --ondisk mmcblk0 --no-table --align 4
part /boot --source bootimg-partition --ondisk mmcblk0 --fstype=vfat --label boot --active --align 61440
part / --source rootfs --ondisk mmcblk0 --fstype=ext4 --label root --align 4096
```

## wrlinux-overc/conf/distro/include/wrlinux-overc-blacklist.conf
```bitbake
#
# Copyright (C) 2018 Wind River Systems, Inc.
#
# Explicitly disallow these recipes in wrlinux-overc
#

PNBLACKLIST[busybox] = "The busybox package is incompatible with meta-overc/meta-cube"
PNBLACKLIST[initramfs-live-boot-tiny] = "Requires busybox, which is disabled."
```
