## wrlinux-overc/conf/distro/include/wrlinux-overc-whitelist.conf
```bitbake
#
# Copyright (C) 2018 Wind River Systems, Inc.
#
# Explicitly allow these recipes in wrlinux-overc
#

# Whitelist the whole wrlinux-overc layer
PNWHITELIST_LAYERS_remove = "wrlinux-overc"
PNWHITELIST_LAYERS_remove = "overc"
PNWHITELIST_LAYERS_remove = "cube"

PNWHITELIST_cloud-services-layer_append = " \
    consul \
"

PNWHITELIST_filesystems-layer_append = " \
    fuse \
"

PNWHITELIST_gnome-layer_append = " \
    gnome-keyring \
    libgnome-keyring \
    network-manager-applet \
"

PNWHITELIST_meta-python_append = " \
    python3-automat \
    python3-click \
    python3-constantly \
    python3-flask \
    python3-hyperlink \
    python3-incremental \
    python3-itsdangerous \
    python3-jinja2 \
    python3-markupsafe \
    python3-pytz \
    python3-simplejson \
    python3-pyserial \
    python3-twisted \
    python3-pyhamcrest \
    python3-bcrypt \
    python3-pickle \
    python3-werkzeug \
    python3-zopeinterface \
"

PNWHITELIST_multimedia-layer_append = " \
    tremor \
"

PNWHITELIST_networking-layer_append = " \
    bridge-utils \
    ebtables \
    netcat \
    netcat-openbsd \
    netcf \
    ntp \
    tcpdump \
    traceroute \
"

PNWHITELIST_openembedded-layer_append = " \
    augeas \
    bdwgc \
    fbset \
    fbset-modes \
    gnulib \
    jq \
    libxaw \
    mailx \
    mime-support \
    onig \
    pps-tools \
    pv \
    sg3-utils \
    smartmontools \
    xterm \
    yajl \
    zile \
"

PNWHITELIST_security_append = " \
    libseccomp \
"

PNWHITELIST_selinux_append = " \
    libselinux \
    libsepol \
"

PNWHITELIST_virtualization-layer_append = " \
    compose-file \
    containerd-opencontainers \
    docker \
    go-capability \
    go-cli \
    go-connections \
    go-context \
    go-dbus \
    go-digest \
    go-distribution \
    go-errors \
    go-fsnotify \
    go-logrus \
    go-mux \
    go-patricia \
    go-pty \
    go-systemd \
    grpc-go \
    libvirt \
    lxc \
    notary \
    oci-image-spec \
    oci-image-tools \
    oci-runtime-spec \
    oci-runtime-tools \
    oci-systemd-hook \
    openvswitch \
    runc-docker \
    riddler \
    spf13-cobra \
    spf13-pflag \
    tini \
    cri-o \
    cri-o-config \
    docker-distribution \
    cni \
    kubernetes \
"
```

## wrlinux-overc/conf/distro/wrlinux-overc.conf
```bitbake
#@TYPE: Distro
#@NAME: Wind River Linux OverC
#@DESCRIPTION: Wind River Linux (OverC)

# Temporary workaround, kernel 5.0 is now gone, 5.2 is standard
PREFERRED_VERSION_linux-yocto ?= "5.2%"
PREFERRED_VERSION_linux-yocto_qemux86 ?= "5.2%"
PREFERRED_VERSION_linux-yocto_qemux86-64 ?= "5.2%"
PREFERRED_VERSION_linux-yocto_qemuarm ?= "5.2%"
PREFERRED_VERSION_linux-yocto_qemumips ?= "5.2%"
PREFERRED_VERSION_linux-yocto_qemumips64 ?= "5.2%"
PREFERRED_VERSION_linux-yocto_qemuppc ?= "5.2%"

# Use the overc distribution as-is.  Do not change distribution configuration
# in this file!
require conf/distro/overc.conf

DISTROOVERRIDES_append = "${@['', ':'][(d.getVar('DISTRO', True) != '')]}osv-wrlinux"

# We want to globally disable wic for any overc usage.  OverC has it's own
# image generation method.
IMAGE_FSTYPES_remove = "wic wic.bmap"

# 'unlock' the build-sysroots recipe from signature checking
SIGGEN_UNLOCKED_RECIPES ?= "build-sysroots"

# This is the one exception, for branding purposes
DISTRO_NAME = "Wind River Linux OverC"

require conf/distro/include/wrlinux-overc-blacklist.conf
require conf/distro/include/wrlinux-overc-whitelist.conf

# Enforce our configuration as immutable
OE_IMPORTS += "overc.immutable"
BB_SIGNATURE_HANDLER = "OverCBasicHash"

include ${@'conf/distro/include/${MACHINE}-lockdown.inc' if (not d.getVar('SIGGEN_OVERC_DEVEL') or d.getVar('SIGGEN_OVERC_DEVEL') == '0') else ''}

BANNER[wrlinux-overc_distro_A] = "${@'Development Mode Enabled, ignoring hashes' if (d.getVar('SIGGEN_OVERC_DEVEL') and d.getVar('SIGGEN_OVERC_DEVEL') != '0') else ''}"

# Load our package revision information
include ${@'conf/distro/include/pr-lockdown.inc' if (not d.getVar('PRSERV_OVERC_DEVEL') or d.getVar('PRSERV_OVERC_DEVEL') == '0') else''}

BANNER[wrlinux-overc_distro_B] = "${@'Development Mode Enabled, ignoring locked PR values' if (d.getVar('PRSERV_OVERC_DEVEL') and d.getVar('PRSERV_OVERC_DEVEL') != '0') else ''}"
```

## wrlinux-overc/conf/layer.conf
```bitbake
#
# Copyright (C) 2018 Wind River Systems, Inc.
#

# We have a conf and classes directory, add to BBPATH
BBPATH =. "${LAYERDIR}:"

# We have a packages directory, add to BBFILES
BBFILES += "${@bb.utils.contains('DISTRO', 'overc', '${LAYERDIR}/recipes-*/*/*.bb  ${LAYERDIR}/recipes-*/*/*.bbappend', '', d)}"

BBFILE_COLLECTIONS += "wrlinux-overc"
BBFILE_PATTERN_wrlinux-overc = ""
BBFILE_PRIORITY_wrlinux-overc = "7"

# This should only be incremented on significant changes that will
# cause compatibility issues with other layers
LAYERVERSION_wrlinux-overc = "1"

LAYERSERIES_COMPAT_wrlinux-overc = "thud wrl warrior"

LAYER_PATH_wrlinux-overc = "${LAYERDIR}"

BB_HASHBASE_WHITELIST_append = " LAYER_PATH_wrlinux-overc"

LAYERDEPENDS_wrlinux-overc = "\
    core \
    wr-template \
    wrlinux \
    overc \
    cube \
    wrlinux-overc-cfg \
    ostree \
"
```

## wrlinux-ovp/conf/distro/include/wrlinux-ovp-whitelist.conf
```bitbake
#
# Copyright (C) 2017 Wind River Systems, Inc.
#
# Explicitly allow these recipes in wrlinux
#

# Whitelist the whole wrlinux-distro layer
PNWHITELIST_LAYERS_remove = "wrlinux-ovp"

# Whitelist for meta-cloud-services
PNWHITELIST_cloud-services-layer_append = " \
    celt051 \
    glusterfs \
    librdmacm \
"

# Whitelist for meta-openembedded/meta-filesystems
PNWHITELIST_filesystems-layer_append = " \
    aufs-util \
    fuse \
    xfsdump \
    xfsprogs \
"

PNWHITELIST_dpdk_append = " \
    dpdk \
"

PNWHITELIST_meta-python_append = " \
    python3-appdirs \
    python3-automat \
    python3-click \
    python3-constantly \
    python3-hyperlink \
    python3-incremental \
    python3-pyserial \
    python3-twisted \
    python3-pyhamcrest \
    python3-bcrypt \
    python3-pickle \
    python3-zopeinterface \
    python-cython \
    python3-prettytable \
    python-protobuf \
"

PNWHITELIST_networking-layer_append = " \
    bridge-utils \
    ebtables \
    netcf \
    tunctl \
    spice \
    spice-protocol \
"

# Whitelist for meta-openembedded/meta-oe
PNWHITELIST_openembedded-layer_append = " \
    augeas \
    byacc \
    gd \
    gnulib \
    hwloc \
    leveldb \
    lua \
    protobuf \
    protobuf-c \
    rabbitmq-c \
    rocksdb \
    gflags \
    yajl \
    libnet \
    snappy \
    zabbix \
    openldap \
"

# Whitelist for meta-realtime
PNWHITELIST_realtime_append = " \
    schedtool-dl \
"

# Whitelist for meta-virtualization
PNWHITELIST_virtualization-layer_append = " \
    ceph \
    cgroup-lite \
    compose-file \
    containerd-opencontainers \
    criu \
    diod \
    docker \
    docker-distribution \
    tini \
    go-systemd \
    go-capability \
    grpc-go \
    go-logrus \
    go-pty \
    go-mux \
    go-distribution \
    go-patricia \
    go-fsnotify \
    go-dbus \
    go-context \
    go-cli \
    go-connections \
    libibverbs \
    libvirt \
    libvmi \
    lxc \
    nagios-core \
    nagios-nrpe \
    nagios-nsca \
    nagios-plugins \
    notary \
    oath \
    openvswitch \
    runc-docker \
"

# Whitelist for meta-webserver
PNWHITELIST_webserver_append = " \
    fcgi \
"
```

## wrlinux-ovp/conf/distro/wrlinux-ovp.conf
```bitbake
# Set this before including wrlinux.conf just in case that
# also tries to set it.
#

#@TYPE: Distro
#@NAME: Wind River Linux OVP
#@DESCRIPTION: Wind River Linux (Open Virtualization)

PREFERRED_PROVIDER_virtual/kernel = "linux-yocto-rt"
PREFERRED_VERSION_virtual/kernel = "4.14%"

# do_kernel_version_sanity_check checks if the defined version and the
# version that is written in the source are the same. Before release we
# directly use Yocto kernel which often gets updated. So this check is
# not so meaningful. We skip it here.
KERNEL_VERSION_SANITY_SKIP = "1"

require conf/distro/wrlinux.conf
require conf/distro/include/wrlinux-ovp-whitelist.conf

# Note that layer.conf will only add items to BBFILES for
# the wrlinux-ovp distro (this one).
#
DISTRO_NAME = "Wind River Linux OVP"

# OVP distro should not be built for non-x86 archs
INHERIT += "compatible-archs"

# Set software versions
PREFERRED_VERSION_openvswitch = "2.7.1+%"
PREFERRED_VERSION_lxc = "2.0.8"
PREFERRED_VERSION_dpdk = "17%"

# Set preferred providers
PREFERRED_PROVIDER_virtual/monitoring ?= "${@bb.utils.contains('MONITORING_FEATURES', 'zabbix', 'packagegroup-zabbix-monitoring',\
    bb.utils.contains('MONITORING_FEATURES', 'nagios', 'packagegroup-nagios-monitoring', 'packagegroup-empty-monitoring', d),d)}"

PREFERRED_PROVIDER_virtual/libibverbs ?= "libibverbs"

# By default including ovp layer will build Nagios core
MONITORING_FEATURES ?= "nagios core"

DISTRO_FEATURES_append = " virtualization kvm"
```

## wrlinux-ovp/conf/layer.conf
```bitbake
#
# Copyright (C) 2017 Wind River Systems, Inc.
#

# We have a conf and classes directory, add to BBPATH
BBPATH =. "${LAYERDIR}:"

# We have a packages directory, add to BBFILES
BBFILES += "${LAYERDIR}/recipes-*/*/*.bb \
        ${LAYERDIR}/recipes-*/*/*.bbappend"

BBFILE_COLLECTIONS += "wrlinux-ovp"
BBFILE_PATTERN_wrlinux-ovp = "^${LAYERDIR}/"
BBFILE_PRIORITY_wrlinux-ovp = "7"

# Ignore a broken bbappend
BBMASK += "${LAYERDIR}/recipes-devtools/qemu/qemu_2.7.0.bbappend"

# This should only be incremented on significant changes that will
# cause compatibility issues with other layers
LAYERVERSION_wrlinux-ovp = "1"

LAYER_PATH_wrlinux-ovp = "${LAYERDIR}"

# meta-intel is needed for dpdk
LAYERDEPENDS_wrlinux-ovp = "\
    core \
    wr-template \
    wrlinux \
    wrlinux-distro \
    virtualization-layer \
    cloud-services-layer \
    realtime \
    dpdk \
"
LAYERRECOMMENDS_wrlinux-ovp = "wrlinux-ovp-dl"

# Custom licenses used by some packages in this layer
OVP_EXTRA_LIC_DIR := "${LAYERDIR}/files/custom-licenses"
LICENSE_PATH[vardepsexclude] += "OVP_EXTRA_LIC_DIR"
LICENSE_PATH += "${OVP_EXTRA_LIC_DIR}"

LAYERSERIES_COMPAT_wrlinux-ovp = "rocko wrl"
```
