## wrlinux-distro/conf/distro/include/wrlinux-bsp-qemumips64.inc
```bitbake
MULTILIB_GLOBAL_VARIANTS_append = " libn32"
MULTILIBS ?= "multilib:lib32 multilib:libn32"
DEFAULTTUNE_virtclass-multilib-lib32 ?= "mips"
DEFAULTTUNE_virtclass-multilib-libn32 ?= "mips64-n32"
```

## wrlinux-distro/conf/distro/include/wrlinux-bsp-qemux86-64.inc
```bitbake
MULTILIBS ?= "multilib:lib32" 
DEFAULTTUNE_virtclass-multilib-lib32 ?= "core2-32"
```

## wrlinux-distro/conf/distro/include/wrlinux-distro-settings.conf
```bitbake
# The recipes which are needed adjust during the build

# Workaround when DEBUG_BUILD = "1"
CFLAGS_remove_pn-glibc_x86 = " -fno-omit-frame-pointer"
ERROR_QA_append_pn-glibc-locale = " host-user-contaminated"
```

## wrlinux-distro/conf/distro/include/wrlinux-installer-whitelist.inc
```bitbake
PNWHITELIST_LAYERS_remove = "meta-anaconda"

# Whitelist for meta-openembedded/meta-gnome
PNWHITELIST_gnome-layer += "\
    gnome-themes \
    gtk-engines \
    keybinder \
    libgnomekbd \
    libgnome-keyring \
    libtimezonemap \
    libuser \
    metacity \
    network-manager-applet \
    usermode \
    libgtop \
"

# Whitelist for meta-openembedded/meta-python
PNWHITELIST_meta-python += "\
    python3-blivet \
    python3-blivetgui \
    python3-coverage \
    python3-langtable \
    python3-meh \
    python3-ntplib \
    python3-ordered-set \
    python3-pid \
    python3-prctl \
    python3-pydbus \
    python3-pykickstart \
    python3-pyparted \
    python3-pytz \
    python3-pyudev \
    python3-requests-file \
    python3-requests-ftp \
    python3-setuptools-scm \
    python3-systemd \
    python3-wrapt \
"

# Whitelist for meta-openembedded/meta-filesystems
PNWHITELIST_filesystems-layer += "\
    fuse \
    ntfs-3g-ntfsprogs \
    xfsprogs \
"

# Whitelist for meta-openembedded/meta-oe
PNWHITELIST_openembedded-layer += "\
    augeas \
    libpwquality \
    libreport \
    libtar \
    fltk \
    glade \
    gnome-doc-utils-stub \
    gnulib \
    isomd5sum \
    satyr \
    tigervnc \
    uthash \
    xmlrpc-c \
"
```

## wrlinux-distro/conf/distro/include/wrlinux-uninative.inc
```bitbake
#
# This include points at uninative tarballs generated and maintained
# by the Yocto Project. These file can be included by distros if they
# want to use/maintain a unified sstate feed for native/cross artefacts
# rather than the feeds having native/cross artefacts which are specific
# to the distro running on the build machine.
#
# To rebuild uninative tarball:
# - Set SDKMACHINE to "x86_64" or "i686"
# - $ bitbake uninative-tarball
# - Save tmp/deploy/sdk/${SDK_ARCH}-nativesdk-libc.tar.bz2 to a directory <uninative_dir>
# - Update UNINATIVE_URL to <uninative_dir>
# - Update UNINATIVE_CHECKSUM with "sha256sum ${SDK_ARCH}-nativesdk-libc.tar.bz2"
#
INHERIT += "uninative"

YOCTO_UNINATIVE_INC ?= "conf/distro/include/yocto-uninative.inc"
YOCTO_UNINATIVE_INC_poky = ""
require ${YOCTO_UNINATIVE_INC}

# The local fetcher (file://) doesn't verify checksum, which means that there
# is no error when yocto-uninative.inc is updated, this is not what we need.
# Put checksum into UNINATIVE_URL, and move the tarball into a directory named
# by checksum, so that we will get errors when it is updated.
#
UNINATIVE_URL = "file://${LAYER_PATH_wrlinux}/files/uninative-tarballs/${@d.getVarFlag('UNINATIVE_CHECKSUM', '${BUILD_ARCH}')}/"
UNINATIVE_CHECKSUM[aarch64] = "e76a45886ee8a0b3904b761c17ac8ff91edf9811ee455f1832d10763ba794dfc"
UNINATIVE_CHECKSUM[i686] = "810d027dfb1c7675226afbcec07808770516c969ee7378f6d8240281083f8924"
UNINATIVE_CHECKSUM[x86_64] = "9498d8bba047499999a7310ac2576d0796461184965351a56f6d32c888a1f216"
```

## wrlinux-distro/conf/distro/wrlinux-common.inc
```bitbake
#
# Copyright (C) 2012 - 2019 Wind River Systems, Inc.
#
# information common to all wrlinux distros
#

require conf/distro/include/wrlinux-base-whitelist.inc

# Provide a way to override default machine behavior for all WRLinux distros
# We need this to add multilib support to the built-in QEMU BSPs
include conf/distro/include/wrlinux-bsp-${MACHINE}.inc

MAINTAINER = "Wind River <info@windriver.com>"

DISTRO_NAME ?= "${WRLINUX_BRANDING}${WRLINUX_VARIANT} ${WRLINUX_BRANCH}"

DISTRO_VERSION ?= "${WRLINUX_VERSION}"
SDK_VERSION ?= "${WRLINUX_PRODUCT_VERSION}"
DISTRO_PRETTY_VERSION ?= "${WRLINUX_PRODUCT_VERSION}${@' Update ${WRLINUX_UPDATE_VERSION}' if d.getVar('WRLINUX_UPDATE_VERSION') != '0' else ''}"

SDK_VENDOR = "-wrlinuxsdk"
TARGET_VENDOR = "-wrs"

# Append 'osv-wrlinux' to the DISTROOVERRIDE
DISTROOVERRIDES_append = "${@['', ':'][(d.getVar('DISTRO', True) != '')]}osv-wrlinux"

LOCALCONF_VERSION = "1"

SDK_NAME = "${DISTRO}-${TCLIBC}-${SDK_ARCH}-${TARGET_ARCH}"
SDKPATH = "/opt/windriver/${DISTRO}/${SDK_VERSION}"
TCSDKMACH = "${@['', '_${SDK_OS}']['${SDK_OS}' != 'linux']}"
TOOLCHAIN_OUTPUTNAME = "${DISTRO}-${DISTRO_VERSION}-${TCLIBC}-${SDK_ARCH}${TCSDKMACH}-${MACHINE_ARCH}-${PN}-sdk"
TOOLCHAINEXT_OUTPUTNAME = "${DISTRO}-${DISTRO_VERSION}-${TCLIBC}-${SDK_ARCH}${TCSDKMACH}-${MACHINE_ARCH}-${PN}-sdk-ext"

TOOLCHAIN_OUTPUTNAME_pn-buildtools-tarball_forcevariable = "${SDK_ARCH}-buildtools-nativesdk-standalone-${DISTRO_VERSION}"

# Workaround for extensible SDK
TOOLCHAIN_OUTPUTNAME_pn-uninative-tarball = "${SDK_ARCH}-nativesdk-libc"

# Add changelist.xml and fs_final*.sh processing
IMAGE_CLASSES += "image-fs_finalize"

# Override these in wrlinux based distros to modify DISTRO_*
WRLINUX_DEFAULT_DISTRO_FEATURES = "largefile multiarch pulseaudio virtualization"
WRLINUX_DEFAULT_EXTRA_RDEPENDS = "packagegroup-core-boot"
WRLINUX_DEFAULT_EXTRA_RRECOMMENDS = "kernel-module-af-packet"

DISTRO_FEATURES ?= "${DISTRO_FEATURES_DEFAULT} ${WRLINUX_DEFAULT_DISTRO_FEATURES}"
DISTRO_FEATURES_class-native ?= "${DISTRO_FEATURES_DEFAULT} ${WRLINUX_DEFAULT_DISTRO_FEATURES}"
DISTRO_FEATURES_class-nativesdk ?= "${DISTRO_FEATURES_DEFAULT} ${WRLINUX_DEFAULT_DISTRO_FEATURES}"
DISTRO_EXTRA_RDEPENDS += " ${WRLINUX_DEFAULT_EXTRA_RDEPENDS}"
DISTRO_EXTRA_RRECOMMENDS += " ${WRLINUX_DEFAULT_EXTRA_RRECOMMENDS}"

# do not include qemu-config by default
#WRLINUXQEMUDEPS = "${@bb.utils.contains("INCOMPATIBLE_LICENSE", "GPLv3", "", "qemu-config",d)}"
WRLINUXQEMUDEPS = ""

DISTRO_EXTRA_RDEPENDS_append_qemuall = " ${WRLINUXQEMUDEPS}"

#TCLIBCAPPEND = ""

#default locale / local language processing settings
IMAGE_LINGUAS ?= ""

# MIRRORS are used only if we don't have a local copy, and the stated upstream
# is no longer available.
MIRRORS =+ "\
bzr://.*/.*      http://downloads.yoctoproject.org/mirror/sources/ \n \
cvs://.*/.*      http://downloads.yoctoproject.org/mirror/sources/ \n \
git://.*/.*      http://downloads.yoctoproject.org/mirror/sources/ \n \
gitsm://.*/.*    http://downloads.yoctoproject.org/mirror/sources/ \n \
hg://.*/.*       http://downloads.yoctoproject.org/mirror/sources/ \n \
osc://.*/.*      http://downloads.yoctoproject.org/mirror/sources/ \n \
p4://.*/.*       http://downloads.yoctoproject.org/mirror/sources/ \n \
svn://.*/.*      http://downloads.yoctoproject.org/mirror/sources/ \n \
ftp://.*/.*      http://downloads.yoctoproject.org/mirror/sources/ \n \
http://.*/.*     http://downloads.yoctoproject.org/mirror/sources/ \n \
https://.*/.*    http://downloads.yoctoproject.org/mirror/sources/ \n"

# The CONNECTIVITY_CHECK_URI's are used to test whether we can succesfully
# fetch from the network (and warn you if not). To disable the test set
# the variable to be empty.
CONNECTIVITY_CHECK_URIS ?= "https://www.example.com/"

# Default hash policy for distro
BB_SIGNATURE_HANDLER ?= 'OEBasicHash'

# Add our license to the acceptable restricted license list
LICENSE_FLAGS_WHITELIST += "commercial_windriver"

# QA check settings - a little stricter than the OE-Core defaults
WARN_TO_ERROR_QA ?= "already-stripped compile-host-path install-host-path \
                    installed-vs-shipped ldflags pn-overrides rpaths staticdev \
                    unknown-configure-option useless-rpaths"
WARN_QA_remove = "${WARN_TO_ERROR_QA}"
ERROR_QA_append = " ${WARN_TO_ERROR_QA}"

# Allow dangling .bbappends for now
BB_DANGLINGAPPENDS_WARNONLY = "1"

# Change base package dependency in -dbg packages from recommends to suggests
RRECOMMENDS_${PN}-dbg = ""
RSUGGESTS_${PN}-dbg = "${PN} (= ${EXTENDPKGV})"

# lsb distro adjust
require conf/distro/include/wrlinux-lsb-distro-adjust.inc

# Make sure DISTRO_FEATURES backfill has pulseaudio 
# this is a temporary fix until pulseaudio is fixed

DISTRO_FEATURES_BACKFILL_CONSIDERED += "pulseaudio"

# Make sure that ldconfig is only enabled when the user has added ldconfig
# to the DISTRO_FEATURES
DISTRO_FEATURES_BACKFILL_CONSIDERED += "ldconfig"

# Make sure that X11 is only enabled in a graphics configuration
DISTRO_FEATURES_BACKFILL_CONSIDERED += "x11"

# Multilib configuration
MULTILIBS ?= ""
MULTILIB_CONF = "${@'conf/multilib.conf' if d.getVar('MULTILIBS') else ''}"
require ${MULTILIB_CONF}

# we usually use gnutls as the default PACKAGECONFIG of wpa-supplicant, but its sub-packege gnutls-openssl
# is GPLv3, so need this check to switch to openssl if GLPv3 is blacklisted.
PACKAGECONFIG_pn-wpa-supplicant ?= "${@bb.utils.contains('INCOMPATIBLE_LICENSE', 'GPLv3', 'openssl', 'gnutls', d)}"

# dnsmasq and named (provided by bind) use the same default port 53:
# | dnsmasq: failed to create listening socket for port 53: Address already in use
# So disable the service by default, and if the user want to use both of them,
# it need to be set to a different port in dnsmasq.conf before starting the service.
INITSCRIPT_PARAMS_pn-dnsmasq = "stop 20 0 1 6 ."
SYSTEMD_AUTO_ENABLE_pn-dnsmasq = "disable"

require conf/distro/include/wrlinux-distro-settings.conf

# Exclude download layers from eSDK.
SDK_LAYERS_EXCLUDE_PATTERN ?= ".*-dl$ .*-dl-[0-9.]+$"

# By default we only support 'standard' kernels.  A machine configuration,
# user, or other configuration file can override this.
TARGET_SUPPORTED_KTYPES ??= "standard"

# Packages blacklisted by default for wrlinux.
PNBLACKLIST[musl] ?= "only glibc is supported for wrlinux"
PNBLACKLIST[musl-utils] ?= "only glibc is supported for wrlinux"

# do_kernel_version_sanity_check in oe-core checks if the defined version in
# metadata(LINUX_VERSION) matches the version written in the source code. For
# release branches we have Jenkins to take care of the version updating. For
# CI/CD branch we aim to use the latest source and directly use Yocto kernel
# source code which frequently gets updated. But oe-core does not tightly follow
# the latest version. We don't necessarily frequently manually bump up the
# version.
KERNEL_VERSION_SANITY_SKIP = "1"

# SANITY_TESTED_DISTROS used to defined the distribution list which we used to build wrlinux
SANITY_TESTED_DISTROS ?= " \
            ubuntu-18.04 \n \
            ubuntu-19.04 \n \
            ubuntu-20.04 \n \
            centos-8 \n \
            fedora-29 \n \
            fedora-30 \n \
            opensuse-151 \n \
            opensuseleap-15.0 \n \
            rhel-7.6 \n \
            rhel-7.7 \n \
            rhel-8.0 \n \
            rhel-8.2 \n \
            sled-15 \n \
            "
```

## wrlinux-distro/conf/distro/wrlinux-graphics.conf
```bitbake
#
# Copyright (C) 2013,2019 Wind River Systems, Inc.
#

#@TYPE: Distro
#@NAME: Wind River Linux Graphics
#@DESCRIPTION: Wind River Linux (Full Featured Distribution with Graphic Support)

WRLINUX_VARIANT = " Graphics"

require conf/distro/wrlinux.conf

DISTRO_FEATURES_append = " x11 opengl wayland vulkan polkit"
```

## wrlinux-distro/conf/distro/wrlinux-installer.conf
```bitbake
#@TYPE: Distro
#@NAME: Wind River Linux Installer
#@DESCRIPTION: Wind River Linux (Anaconda-based Target Installer)

require wrlinux.conf
require conf/distro/anaconda.conf
include include/wrlinux-installer-whitelist.inc

DISTRO = "anaconda"

IMAGE_FSTYPES_pn-wrlinux-image-installer_append = " live"

CUSTOMIZE_LOGOS ?= "windriver-logos"

WRTEMPLATE_SKIP += "feature/installer-support"
```

## wrlinux-distro/conf/distro/wrlinux-small.conf
```bitbake
#
# Copyright (C) 2013 Wind River Systems, Inc.
#

#@TYPE: Distro
#@NAME: Wind River Linux Small
#@DESCRIPTION: Wind River Linux (Busybox Based Distribution)

require conf/distro/wrlinux.conf

VIRTUAL-RUNTIME_no-busybox = ""
VIRTUAL-RUNTIME_login_manager = "busybox"
VIRTUAL-RUNTIME_base-utils = "busybox"
```

## wrlinux-distro/conf/distro/wrlinux-std-sato.conf
```bitbake
#
# Copyright (C) 2019 Wind River Systems, Inc.
#

#@TYPE: Distro
#@NAME: Wind River Linux Standard Sato
#@DESCRIPTION: Wind River Linux (Full Featured Distribution with Sato)

BANNER[distro_wrlinux-std-sato] = "DISTRO wrlinux-std-sato is deprecated, use wrlinux-graphics instead."

require conf/distro/wrlinux-graphics.conf
```
